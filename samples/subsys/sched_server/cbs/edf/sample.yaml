## samples/subsys/sched_server/cbs/edf/sample.yaml
```yaml
sample:
  description: An Earliest Deadline First with Constant Bandwidth Server CBS sample
  name: EDF with CBS sample
common:
  tags:
    - EDF
    - CBS
tests:
  sample.cbs.edf:
    build_only: true
    platform_allow:
      - qemu_x86_64
      - qemu_riscv32
      - qemu_cortex_a53
    integration_platforms:
      - qemu_riscv32
    tags: 
      - cbs
      - edf
```

## subsys/server/cbs/Kconfig
```kconfig
# config options for Constant Bandwidth Server
#
# Copyright (c) 2024 Instituto Superior de Engenharia do Porto (ISEP)
# SPDX-License-Identifier: Apache-2.0

menu "Constant Bandwidth Server (CBS)"

    config CBS
        bool "Constant Bandwidth Server (CBS)"
        depends on SCHED_DEADLINE
        select INSTRUMENT_THREAD_SWITCHING
        default n
        help
            Enables the Constant Bandwidth Server (CBS) to handle soft
            real-time tasks. Depends on Earliest Deadline First (EDF)
            to be selected (CONFIG_SCHED_DEADLINE=y).
    
    config CBS_LOG
        bool "CBS event logs"
        depends on CBS
        select LOG
        default n
        help
            Enables logging of Constant Bandwidth Server (CBS) events,
            such as jobs being pushed to the server, budget consumpion
            and CBS thread switching in/out of the CPU. This option
            requires CONFIG_CBS to be included within the project.

    if CBS
    menu "CBS constants"

        config CBS_THREAD_STACK_SIZE
            int "CBS thread memory"
            default 2048
            help
                The amount of memory to be
                allocated for the CBS thread.
        
        config CBS_QUEUE_LENGTH
            int "CBS job queue length"
            default 16
            help
                The highest number of jobs that can
                be pushed to a CBS job queue at once.

        config CBS_INITIAL_DELAY
            int "CBS thread initial delay"
            default 0
            help
                Scheduling delay (in milliseconds) for the CBS thread.

        if CBS_LOG

        config CBS_THREAD_MAX_NAME_LEN
            int "Max length of the CBS thread name"
            default 20
            help
                CBS thread names are the same as the variables created with
                K_CBS_DEFINE and get stored in the cbs_t struct. This option
                indicates the maximum name length of the CBS server to be
                displayed on log events, including the terminating NULL byte.
                Reducing this value wil help conserving memory, but as a tradeoff
                it might chop a portion the server name on the aforementioned logs.
        
        endif
    endmenu
    endif

endmenu # Constant Bandwidth Server (CBS)
```
